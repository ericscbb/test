/*
   +++++++++++++++++++++++++++++++++++++++++++++++++++++++++++++++++++++++++++++++++
   Copyright (c) 2011 Synaptics, Inc.
   
   Permission is hereby granted, free of charge, to any person obtaining a copy of 
   this software and associated documentation files (the "Software"), to deal in 
   the Software without restriction, including without limitation the rights to use, 
   copy, modify, merge, publish, distribute, sublicense, and/or sell copies of the 
   Software, and to permit persons to whom the Software is furnished to do so, 
   subject to the following conditions:
   
   The above copyright notice and this permission notice shall be included in all 
   copies or substantial portions of the Software.
   
   THE SOFTWARE IS PROVIDED "AS IS", WITHOUT WARRANTY OF ANY KIND, EXPRESS OR 
   IMPLIED, INCLUDING BUT NOT LIMITED TO THE WARRANTIES OF MERCHANTABILITY, 
   FITNESS FOR A PARTICULAR PURPOSE AND NONINFRINGEMENT. IN NO EVENT SHALL THE 
   AUTHORS OR COPYRIGHT HOLDERS BE LIABLE FOR ANY CLAIM, DAMAGES OR OTHER 
   LIABILITY, WHETHER IN AN ACTION OF CONTRACT, TORT OR OTHERWISE, ARISING FROM, 
   OUT OF OR IN CONNECTION WITH THE SOFTWARE OR THE USE OR OTHER DEALINGS IN THE 
   SOFTWARE.
  
   +++++++++++++++++++++++++++++++++++++++++++++++++++++++++++++++++++++++++++++++++
*/

// The following #defines are just needed to define an Image Report BUffer in memory
#define  CFG_F54_TXCOUNT              0xFF           // Number of Transmitters on device under test
#define  CFG_F54_RXCOUNT              0xFF           // Number of Receivers    on device under test
                                                     
#define  IMAGE_SIZE                   (CFG_F54_RXCOUNT * CFG_F54_TXCOUNT)

float UpperLimit[20][28] = {0.3, 0.3, 0.3, 0.3, 0.3, 0.3, 0.3, 0.3, 0.3, 0.3, 0.3, 0.3, 0.3, 0.3, 0.3, 0.3, 0.3, 0.3, 0.3, 0.3,
                            0.3, 0.3, 0.3, 0.3, 0.3, 0.3, 0.3, 0.3, 0.3, 0.3, 0.3, 0.3, 0.3, 0.3, 0.3, 0.3, 0.3, 0.3, 0.3, 0.3,
							0.3, 0.3, 0.3, 0.3, 0.3, 0.3, 0.3, 0.3, 0.3, 0.3, 0.3, 0.3, 0.3, 0.3, 0.3, 0.3, 0.3, 0.3, 0.3, 0.3,
							0.3, 0.3, 0.3, 0.3, 0.3, 0.3, 0.3, 0.3, 0.3, 0.3, 0.3, 0.3, 0.3, 0.3, 0.3, 0.3, 0.3, 0.3, 0.3, 0.3,
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                            0.3, 0.3, 0.3, 0.3, 0.3, 0.3, 0.3, 0.3, 0.3, 0.3, 0.3, 0.3, 0.3, 0.3, 0.3, 0.3, 0.3, 0.3, 0.3, 0.3};

float LowerLimit[20][28] = {5.5, 5.5, 5.5, 5.5, 5.5, 5.5, 5.5, 5.5, 5.5, 5.5, 5.5, 5.5, 5.5, 5.5, 5.5, 5.5, 5.5, 5.5, 5.5, 5.5,
                            5.5, 5.5, 5.5, 5.5, 5.5, 5.5, 5.5, 5.5, 5.5, 5.5, 5.5, 5.5, 5.5, 5.5, 5.5, 5.5, 5.5, 5.5, 5.5, 5.5,
							5.5, 5.5, 5.5, 5.5, 5.5, 5.5, 5.5, 5.5, 5.5, 5.5, 5.5, 5.5, 5.5, 5.5, 5.5, 5.5, 5.5, 5.5, 5.5, 5.5,
							5.5, 5.5, 5.5, 5.5, 5.5, 5.5, 5.5, 5.5, 5.5, 5.5, 5.5, 5.5, 5.5, 5.5, 5.5, 5.5, 5.5, 5.5, 5.5, 5.5,
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                            5.5, 5.5, 5.5, 5.5, 5.5, 5.5, 5.5, 5.5, 5.5, 5.5, 5.5, 5.5, 5.5, 5.5, 5.5, 5.5, 5.5, 5.5, 5.5, 5.5};

char Result[20][28];

static void executeCommand()
{
   unsigned short numberOfRows;
   unsigned short numberOfColumns;
   int i, j, k;
   int length;

   float ImageArray[CFG_F54_TXCOUNT] [CFG_F54_RXCOUNT] ;

   float ImageBuffer[CFG_F54_TXCOUNT*CFG_F54_RXCOUNT*2];

   unsigned short command;

   readRMI(F54_Query_Base, &numberOfColumns, 1);
   readRMI(F54_Query_1, &numberOfRows, 1);
   length = numberOfRows * numberOfColumns * 2;

   // Enabling only the analog image reporting interrupt, and turn off the rest
   command = 0x08;
   writeRMI(F01_RMI_Ctrl1, &command, 1);
   
   k = 0;       
   // Set report mode to to run the AutoScan
   command = 0x03;
   writeRMI(F54_Data_Base, &command, 1);

   command = 0x00;
   writeRMI(F54_Data_LowIndex, &command, 1);
   writeRMI(F54_Data_HighIndex, &command, 1);

   // Set the GetReport bit to run the AutoScan
   command = 0x01;
   writeRMI(F54_Command_Base, &command, 1);

   // Wait until the command is completed
   do {
      readRMI(F54_Command_Base, &command, 1);
   } while (command == 0x01);

   readRMI(F54_Data_Buffer, &ImageBuffer[0], length);

   for (i = 0; i < numberOfRows; i++)
   {
       for (j = 0; j < numberOfColumns; j++)
	   {
		 ImageArray[i][j] = (float)(ImageBuffer[k] | (ImageBuffer[k+1] << 8));
		 k = k + 2;
	   }  	  
   }

   // Check against test limits
   printf("\nThe test result:\n");
   for (i = 0; i < 20; i++)
   {   
       printf("[ ");
	   for (j = 0; j < 28; j++)
	   {
		    if ((ImageArray[i][j] < UpperLimit[i][j]) &&
				(ImageArray[i][j] > LowerLimit[i][j]))
	   			Result[i][j] = "P" /*Pass*/
			else
			    Result[i][j] = "F" /*Fail*/
			printf("%c (%2.1f), ", Result[i][j], ImageArray[i][j]);
	   }
	   printf("]\n");
   }
}




